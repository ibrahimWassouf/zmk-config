#include "skeletyl.dtsi"

&kscan0 {
	row-gpios
		= <&pro_micro X (GPIO_ACTIVE_HIGH | GPIO_PULL_DOWN)>
		, <&pro_micro X (GPIO_ACTIVE_HIGH | GPIO_PULL_DOWN)>
        , <&pro_micro X (GPIO_ACTIVE_HIGH | GPIO_PULL_DOWN)>
        , <&pro_micro X (GPIO_ACTIVE_HIGH | GPIO_PULL_DOWN)>
		;
	col-gpios
		= 
		, <&pro_micro X (GPIO_ACTIVE_HIGH)>
		, <&pro_micro X (GPIO_ACTIVE_HIGH)>
		, <&pro_micro X (GPIO_ACTIVE_HIGH)>
		, <&pro_micro X (GPIO_ACTIVE_HIGH)>
		;
};
